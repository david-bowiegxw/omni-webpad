## firmware/platform/esp32/main/Kconfig.projbuild
```kconfig
menu "OmniWebPad"

    config OMNIWEBPAD_BUTTON_GPIO
        int "Factory reset button GPIO (-1 disables)"
        default 9 if IDF_TARGET_ESP32C3 || IDF_TARGET_ESP32C6
        default 0
        help
            Active-low button, normally the BOOT button of the dev board.
            Holding it for five seconds restores the default settings.

    config OMNIWEBPAD_LED_GPIO
        int "Status LED GPIO (-1 disables)"
        default -1
        help
            Plain (not addressable) LED: on while a host is connected,
            blinking while waiting.

    config OMNIWEBPAD_LED_ACTIVE_LOW
        bool "Status LED is active low"
        default n

endmenu
```

## firmware/platform/esp32/sdkconfig.defaults
```kconfig
# Common to every target.
CONFIG_FREERTOS_HZ=1000
CONFIG_ESP_MAIN_TASK_STACK_SIZE=8192
CONFIG_PARTITION_TABLE_SINGLE_APP_LARGE=y
CONFIG_COMPILER_OPTIMIZATION_PERF=y
CONFIG_LWIP_MAX_SOCKETS=12
CONFIG_ESP_WIFI_SOFTAP_SUPPORT=y
CONFIG_LOG_DEFAULT_LEVEL_WARN=y
```
